## pkg/usb/test_app/sdkconfig.defaults
```kconfig
#
# Build type
#
CONFIG_APP_REPRODUCIBLE_BUILD=y

#
# Ultra Low Power (ULP) Co-processor
#
CONFIG_ULP_COPROC_ENABLED=y
CONFIG_ULP_COPROC_TYPE_FSM=y
CONFIG_ULP_COPROC_RESERVE_MEM=8176
```
